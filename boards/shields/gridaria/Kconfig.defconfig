## config/west.yml
```yaml
manifest:
  remotes:
    - name: zmkfirmware
      url-base: https://github.com/zmkfirmware
    - name: badjeff
      url-base: https://github.com/badjeff
  projects:
    - name: zmk
      remote: zmkfirmware
      revision: main
      import: app/west.yml
    - name: analog-axis-hires-input-zephyr-module
      remote: badjeff
      revision: main
  self:
    path: config
```

## dts/bindings/behaviors/zmk,behavior-battery-led.yaml
```yaml
# Copyright (c) 2026 Cerbekos
# SPDX-License-Identifier: GPL-2.0-or-later

description: Display battery charge on the underglow while held

compatible: "zmk,behavior-battery-led"

include: zero_param.yaml
```

## dts/bindings/behaviors/zmk,behavior-bt-led.yaml
```yaml
# Copyright (c) 2026 Cerbekos
# SPDX-License-Identifier: GPL-2.0-or-later

description: Bluetooth profile behavior with per-profile LED feedback

compatible: "zmk,behavior-bt-led"

include: two_param.yaml
```

## dts/bindings/behaviors/zmk,behavior-fader-layer.yaml
```yaml
# Copyright (c) 2026 Cerbekos
# SPDX-License-Identifier: GPL-2.0-or-later

description: No-op behavior used to configure Gridaria's fader layer assignments

compatible: "zmk,behavior-fader-layer"

include: one_param.yaml
```

## dts/bindings/kscan/zmk,kscan-gpio-duplex.yaml
```yaml
description: Bidirectional GPIO matrix controller for duplex keyboards

compatible: "zmk,kscan-gpio-duplex"

include: kscan.yaml

properties:
  row-gpios:
    type: phandle-array
    required: true
  col-gpios:
    type: phandle-array
    required: true
  debounce-press-ms:
    type: int
    default: 5
  debounce-release-ms:
    type: int
    default: 5
  poll-period-ms:
    type: int
    default: 1
```
