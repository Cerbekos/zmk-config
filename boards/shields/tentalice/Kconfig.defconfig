## config/dts/bindings/behavior/battery_status.yaml
```yaml
compatible: "zmk,behavior-battery-status"
include: "behavior-metadata.yaml"

properties:
  label:
    type: string
    required: true

# この部分が重要！
"#binding-cells": 1
```
